/ {
    chosen {
        zmk,kscan = &kscan0;
        zmk,bt-name = "";

    };
};

&kscan0 {
    compatible = "zmk,kscan-gpio";
    diode-direction = "col2row";

    row-gpios = <&gpio1 13 (GPIO_ACTIVE_LOW)>,  // P1.13
                <&gpio0 31 (GPIO_ACTIVE_LOW)>,  // P0.31
                <&gpio0 6  (GPIO_ACTIVE_LOW)>,  // P0.06
                <&gpio0 11 (GPIO_ACTIVE_LOW)>,  // P0.11
                <&gpio0 22 (GPIO_ACTIVE_LOW)>;  // P0.22

    col-gpios = <&gpio0 8  (GPIO_ACTIVE_LOW)>,  // P0.08
                <&gpio0 24 (GPIO_ACTIVE_LOW)>,  // P0.24
                <&gpio0 10 (GPIO_ACTIVE_LOW)>,  // P0.10
                <&gpio1 11 (GPIO_ACTIVE_LOW)>,  // P1.11
                <&gpio0 29 (GPIO_ACTIVE_LOW)>,  // P0.29
                <&gpio0 17 (GPIO_ACTIVE_LOW)>,  // P0.17
                <&gpio0 2  (GPIO_ACTIVE_LOW)>;  // P0.02
};

// BLE-Rolle: Peripheral
&zmk_ble {
    compatible = "zmk,ble";
    role = "peripheral";
};
